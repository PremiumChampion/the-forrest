## boards/arm/nrf52840_dk/Kconfig.defconfig
```kconfig
# Copyright (c) 2024 Nordic Semiconductor ASA
# SPDX-License-Identifier: Apache-2.0

if BOARD_NRF52840_DK

config BOARD
	default "nrf52840_dk"

config BT_CTLR
   default BT


endif
```
