## CMakeLists.txt
```
# SPDX-License-Identifier: Apache-2.0

cmake_minimum_required(VERSION 3.20.0)
find_package(Zephyr REQUIRED HINTS $ENV{ZEPHYR_BASE})
project(nrf_system_off)

target_sources(app PRIVATE src/main.c)
if (CONFIG_APP_USE_NRF_RETENTION OR CONFIG_APP_USE_RETAINED_MEM)
  target_sources(app PRIVATE src/retained.c)
endif()
```

## Kconfig
```
# Copyright (c) 2021 Nordic Semiconductor ASA
# SPDX-License-Identifier: Apache-2.0

mainmenu "Nordic SYSTEM_OFF demo"

choice
	prompt "Use retention"
	optional

config APP_USE_NRF_RETENTION
	bool "Use state retention in system off using nRF POWER"
	depends on SOC_COMPATIBLE_NRF52X && CRC
	help
	  On some Nordic chips this application supports retaining
	  memory while in system off using POWER peripheral.
	  Select this to enable the feature.

config APP_USE_RETAINED_MEM
	bool "Use state retention in system off using retained_mem driver"
	depends on RETAINED_MEM

endchoice

config GRTC_WAKEUP_ENABLE
	bool "Use GRTC to wake up device from system off"
	help
	  Switch wake up source from pressing sw0 button to GRTC

source "Kconfig.zephyr"
```

## sample.yaml
```
sample:
  name: Low Power State Sample for nRF5x
common:
  tags: power
tests:
  sample.boards.nrf.system_off:
    integration_platforms:
      - nrf52840dk/nrf52840
    platform_allow:
      - nrf51dk/nrf51822
      - nrf52840dk/nrf52840
      - nrf52dk/nrf52832
      - nrf5340dk/nrf5340/cpuapp
      - nrf54l15dk/nrf54l05/cpuapp
      - nrf54l15dk/nrf54l10/cpuapp
      - nrf54l15dk/nrf54l15/cpuapp
    harness: console
    harness_config:
      type: multi_line
      ordered: true
      regex:
        - "system off demo"
        - "Retained data not supported"
        - "Entering system off; press sw0 to restart"
  sample.boards.nrf.system_off.nrf_retained:
    integration_platforms:
      - nrf52840dk/nrf52840
    platform_allow:
      - nrf52840dk/nrf52840
      - nrf52dk/nrf52832
    extra_configs:
      - CONFIG_APP_USE_NRF_RETENTION=y
    harness: console
    harness_config:
      type: multi_line
      ordered: true
      regex:
        - "system off demo"
        - "Retained data: INVALID"
        - "Boot count: 1"
        - "Off count: 0"
        - "Active Ticks:"
        - "Entering system off; press sw0 to restart"
  sample.boards.nrf.system_off.retained_mem:
    extra_args: DTC_OVERLAY_FILE="boards/nrf54l15dk_nrf54l15_cpuapp_retained_mem.overlay"
    platform_allow:
      - nrf54l15dk/nrf54l15/cpuapp
    extra_configs:
      - CONFIG_APP_USE_RETAINED_MEM=y
      - CONFIG_RETAINED_MEM=y
    harness: console
    harness_config:
      type: multi_line
      ordered: true
      regex:
        - "system off demo"
        - "Retained data: INVALID"
        - "Boot count: 1"
        - "Off count: 0"
        - "Active Ticks:"
        - "Entering system off; press sw0 to restart"
  sample.boards.nrf.system_off.grtc_wakeup:
    platform_allow:
      - nrf54l15dk/nrf54l15/cpuapp
    extra_configs:
      - CONFIG_GRTC_WAKEUP_ENABLE=y
    harness: console
    harness_config:
      type: multi_line
      ordered: true
      regex:
        - "system off demo"
        - "Retained data not supported"
        - "Entering system off; wait 2 seconds to restart"
        - "system off demo"
        - "Retained data not supported"
        - "Entering system off; wait 2 seconds to restart"
        - "system off demo"
        - "Retained data not supported"
        - "Entering system off; wait 2 seconds to restart"
  sample.boards.nrf.system_off.retained_mem.grtc_wakeup:
    extra_args: DTC_OVERLAY_FILE="boards/nrf54l15dk_nrf54l15_cpuapp_retained_mem.overlay"
    platform_allow:
      - nrf54l15dk/nrf54l15/cpuapp
    extra_configs:
      - CONFIG_APP_USE_RETAINED_MEM=y
      - CONFIG_GRTC_WAKEUP_ENABLE=y
      - CONFIG_RETAINED_MEM=y
    harness: console
    harness_config:
      type: multi_line
      ordered: true
      regex:
        - "system off demo"
        - "Retained data: INVALID"
        - "Boot count: 1"
        - "Off count: 0"
        - "Active Ticks:"
        - "Entering system off; wait 2 seconds to restart"
        - "system off demo"
        - "Retained data: valid"
        - "Boot count: 2"
        - "Off count: 1"
        - "Active Ticks:"
        - "Entering system off; wait 2 seconds to restart"
```

## prj.conf
```kconfig
CONFIG_PM=y
CONFIG_PM_DEVICE=y
CONFIG_PM_POLICY_DEFAULT=y
CONFIG_PM_DEVICE_RUNTIME=y
CONFIG_GPIO=y
CONFIG_CRC=y
CONFIG_POWEROFF=y
```

## nrf52dk_nrf52832.overlay
```dts
// To get started, press Ctrl+Space (or Option+Esc) to bring up the completion menu and view the available nodes.

// You can also use the buttons in the sidebar to perform actions on nodes.
// Actions currently available include:

// * Enabling / disabling the node
// * Adding the bus to a bus
// * Removing the node
// * Connecting ADC channels

// For more help, browse the DeviceTree documentation at https://docs.zephyrproject.org/latest/guides/dts/index.html
// You can also visit the nRF DeviceTree extension documentation at https://docs.nordicsemi.com/bundle/nrf-connect-vscode/page/guides/ncs_configure_app.html#devicetree-support-in-the-extension
&gpio0 {
    wakeup-source;
};
```

## src/main.c
```c
#include <inttypes.h>
#include <stdio.h>
#include <zephyr/device.h>
#include <zephyr/drivers/gpio.h>
#include <zephyr/pm/device.h>
#include <zephyr/kernel.h>
#include <zephyr/sys/poweroff.h>
#include <zephyr/sys/util.h>

static const struct gpio_dt_spec sw0 = GPIO_DT_SPEC_GET(DT_ALIAS(sw0), gpios);
const struct device *const cons = DEVICE_DT_GET(DT_CHOSEN(zephyr_console));

typedef enum {
    MODE_IDLE,
    MODE_SLEEP
} system_mode_t;

static volatile system_mode_t current_mode = MODE_IDLE;

/* Button callback function */
static void button_pressed(const struct device *dev, struct gpio_callback *cb, uint32_t pins)
{
    int rc;
    if (current_mode == MODE_IDLE) {
        printf("Switching to Sleep Mode\n");
        rc = pm_device_action_run(cons, PM_DEVICE_ACTION_SUSPEND);
        if (rc < 0) {
            printf("Could not suspend console (%d)\n", rc);
            return;
        }
        current_mode = MODE_SLEEP;
    } else {
        printf("Switching to Idle Mode\n");
        rc = pm_device_action_run(cons, PM_DEVICE_ACTION_RESUME);
        if (rc < 0) {
            printf("Could not resume console (%d)\n", rc);
            return;
        }
        current_mode = MODE_IDLE;
    }
}

static struct gpio_callback button_cb_data;

int main(void)
{
    int rc;

    if (!device_is_ready(cons)) {
        printf("%s: device not ready.\n", cons->name);
        return 0;
    }

    /* Configure sw0 as input and set up interrupt */
    rc = gpio_pin_configure_dt(&sw0, GPIO_INPUT);
    if (rc < 0) {
        printf("Could not configure sw0 GPIO (%d)\n", rc);
        return 0;
    }

    rc = gpio_pin_interrupt_configure_dt(&sw0, GPIO_INT_EDGE_TO_ACTIVE);
    if (rc < 0) {
        printf("Could not configure sw0 GPIO interrupt (%d)\n", rc);
        return 0;
    }

    gpio_init_callback(&button_cb_data, button_pressed, BIT(sw0.pin));
    gpio_add_callback(sw0.port, &button_cb_data);

    printf("Press sw0 to switch modes. Press and hold to power off.\n");

    /* Main loop */
    while (1) {
        if (current_mode == MODE_IDLE) {
            printf("System in IDLE mode...\n");
        } else {
            printf("System in SLEEP mode...\n");
        }
        k_sleep(K_SECONDS(1));

        /* Simulate a condition to power off, e.g., holding the button */
        if (/* Condition to power off */ false) {
            printf("Powering off the system...\n");

            /* Ensure peripherals are suspended before power off */
            rc = pm_device_action_run(cons, PM_DEVICE_ACTION_SUSPEND);
            if (rc < 0) {
                printf("Failed to suspend console before power off (%d)\n", rc);
            }

            /* Power off the system */
            sys_poweroff();
        }
    }

    return 0;
}
```

## src/retained.c
```c
/*
 * Copyright (c) 2021 Nordic Semiconductor ASA
 *
 * SPDX-License-Identifier: Apache-2.0
 */

#include "retained.h"

#include <stdint.h>
#include <string.h>

#include <zephyr/kernel.h>
#include <zephyr/devicetree.h>
#include <zephyr/drivers/retained_mem.h>
#include <zephyr/sys/byteorder.h>
#include <zephyr/sys/crc.h>

#if CONFIG_APP_USE_NRF_RETENTION
#include <hal/nrf_power.h>

/* nRF52 RAM (really, RAM AHB slaves) are partitioned as:
 * * Up to 8 blocks of two 4 KiBy byte "small" sections
 * * A 9th block of with 32 KiBy "large" sections
 *
 * At time of writing the maximum number of large sections is 6, all
 * within the first large block.  Theoretically there could be more
 * sections in the 9th block, and possibly more blocks.
 */

/* Inclusive address of RAM start */
#define SRAM_BEGIN (uintptr_t)DT_REG_ADDR(DT_NODELABEL(sram0))

/* Exclusive address of RAM end */
#define SRAM_END (SRAM_BEGIN + (uintptr_t)DT_REG_SIZE(DT_NODELABEL(sram0)))

/* Size of a controllable RAM section in the small blocks */
#define SMALL_SECTION_SIZE 4096

/* Number of controllable RAM sections in each of the lower blocks */
#define SMALL_SECTIONS_PER_BLOCK 2

/* Span of a small block */
#define SMALL_BLOCK_SIZE (SMALL_SECTIONS_PER_BLOCK * SMALL_SECTION_SIZE)

/* Number of small blocks */
#define SMALL_BLOCK_COUNT 8

/* Span of the SRAM area covered by small sections */
#define SMALL_SECTION_SPAN (SMALL_BLOCK_COUNT * SMALL_BLOCK_SIZE)

/* Inclusive address of the RAM range covered by large sections */
#define LARGE_SECTION_BEGIN (SRAM_BEGIN + SMALL_SECTION_SPAN)

/* Size of a controllable RAM section in large blocks */
#define LARGE_SECTION_SIZE 32768

#elif CONFIG_APP_USE_RETAINED_MEM
const static struct device *retained_mem_device = DEVICE_DT_GET(DT_ALIAS(retainedmemdevice));
#endif

/* Set or clear RAM retention in SYSTEM_OFF for the provided object.
 *
 * @param ptr pointer to the start of the retainable object
 *
 * @param len length of the retainable object
 *
 * @param enable true to enable retention, false to clear retention
 */
static int ram_range_retain(const void *ptr,
			    size_t len,
			    bool enable)
{
	int rc = 0;

#if CONFIG_APP_USE_NRF_RETENTION
	/* This only works for nRF52 with the POWER module.
	 * The other  Nordic chips use a different low-level API,
	 * which is not currently used by this variant.
	 */
	uintptr_t addr = (uintptr_t)ptr;
	uintptr_t addr_end = addr + len;

	/* Error if the provided range is empty or doesn't lie
	 * entirely within the SRAM address space.
	 */
	if ((len == 0U)
	    || (addr < SRAM_BEGIN)
	    || (addr > (SRAM_END - len))) {
		return -EINVAL;
	}

	/* Iterate over each section covered by the range, setting the
	 * corresponding RAM OFF retention bit in the parent block.
	 */
	do {
		uintptr_t block_base = SRAM_BEGIN;
		uint32_t section_size = SMALL_SECTION_SIZE;
		uint32_t sections_per_block = SMALL_SECTIONS_PER_BLOCK;
		bool is_large = (addr >= LARGE_SECTION_BEGIN);
		uint8_t block = 0;

		if (is_large) {
			block = 8;
			block_base = LARGE_SECTION_BEGIN;
			section_size = LARGE_SECTION_SIZE;

			/* RAM[x] supports only 16 sections, each its own bit
			 * for POWER (0..15) and RETENTION (16..31).  We don't
			 * know directly how many sections are present, so
			 * assume they all are; the true limit will be
			 * determined by the SRAM size.
			 */
			sections_per_block = 16;
		}

		uint32_t section = (addr - block_base) / section_size;

		if (section >= sections_per_block) {
			block += section / sections_per_block;
			section %= sections_per_block;
		}

		uint32_t section_mask =
			(POWER_RAM_POWERSET_S0RETENTION_On
					 << (section + POWER_RAM_POWERSET_S0RETENTION_Pos));

		if (enable) {
			nrf_power_rampower_mask_on(NRF_POWER, block, section_mask);
		} else {
			nrf_power_rampower_mask_off(NRF_POWER, block, section_mask);
		}

		/* Move to the first address in the next section. */
		addr += section_size - (addr % section_size);
	} while (addr < addr_end);
#elif CONFIG_APP_USE_RETAINED_MEM
	/* Retention setting cannot be controlled runtime with retained_mem API */
	(void)enable;
	rc = retained_mem_write(retained_mem_device, 0, ptr, len);
#else
	#error "Unsupported retention setting"
#endif

	return rc;
}

/* Retained data must be defined in a no-init section to prevent the C
 * runtime initialization from zeroing it before anybody can see it.
 * It is not necesarry when retained_mem driver is utilized
 * as in this case retained data is stored in an area not initialized in runtime.
 */
__noinit struct retained_data retained;

#define RETAINED_CRC_OFFSET offsetof(struct retained_data, crc)
#define RETAINED_CHECKED_SIZE (RETAINED_CRC_OFFSET + sizeof(retained.crc))

bool retained_validate(void)
{
	/* The residue of a CRC is what you get from the CRC over the
	 * message catenated with its CRC.  This is the post-final-xor
	 * residue for CRC-32 (CRC-32/ISO-HDLC) which Zephyr calls
	 * crc32_ieee.
	 */
	const uint32_t residue = 0x2144df1c;
	uint32_t crc = crc32_ieee((const uint8_t *)&retained,
				  RETAINED_CHECKED_SIZE);
	bool valid = (crc == residue);

	/* If the CRC isn't valid, reset the retained data. */
	if (!valid) {
		memset(&retained, 0, sizeof(retained));
	}

	/* Reset to accrue runtime from this session. */
	retained.uptime_latest = 0;

	/* Reconfigure to retain the state during system off, regardless of
	 * whether validation succeeded.  Although these values can sometimes
	 * be observed to be preserved across System OFF, the product
	 * specification states they are not retained in that situation, and
	 * that can also be observed.
	 */
	(void)ram_range_retain(&retained, RETAINED_CHECKED_SIZE, true);

	return valid;
}

void retained_update(void)
{
	uint64_t now = k_uptime_ticks();

	retained.uptime_sum += (now - retained.uptime_latest);
	retained.uptime_latest = now;

	uint32_t crc = crc32_ieee((const uint8_t *)&retained,
				  RETAINED_CRC_OFFSET);

	retained.crc = sys_cpu_to_le32(crc);
}
```
